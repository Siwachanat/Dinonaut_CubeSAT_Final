#pragma once

/* SunSeek Platform v2.0 — MODULE LAYER

   [Team 2026-10-07] Sun sensing rewritten around the regional-round method.
   Selected in Config_Sensor.h:

     SUN_ALGORITHM 0  organisers' path: NDV = (L-R)/(L+R) on raw counts, then the
                      team function estimateSunAngle(ndv).
     SUN_ALGORITHM 1  conductance ratio + level branch. Tables come from
                      include/Config_SunCal.h (generated by tools/suncal_fit.py).

   Both paths average SUN_OVERSAMPLE interleaved reads per side. With
   SUN_ALGORITHM 0 and SUN_OVERSAMPLE 1 the output is the organisers' v3.0
   behaviour, value for value.

   Algorithm 1, per sample (same arithmetic as tools/suncal_fit.py):

     G      = counts / (COUNTS_AT_VCC - counts)     LDR conductance, in units of 1/R_F
                                                    (LDR to 3V3, R_F to GND)
     X      = ln(G_L) - ln(G_R)                     brightness cancels: both cells
                                                    scale by the same factor
     angle  = table(X)                              "ratio zone"

   Past the edge of the ratio zone one cell is in the baffle's shadow and X folds
   back into the table. That is detected two ways (a cell below its darkness
   threshold, or X off the end of the table) and the angle is then read from the
   level of the cell that is still lit. A level is not brightness-immune, so
   while readings are inside the ratio zone the firmware keeps learning the
   lamp's brightness relative to calibration (ln(G_L+G_R) against the stored
   table) and applies that reference to the level branch and to the thresholds.

   ADC note: GPIO16/17 are ADC2 on the ESP32-S3. BLE is fine, Wi-Fi is not. */

#include <Arduino.h>
#include <math.h>
#include "Config_Sensor.h"

#ifndef SUN_ALGORITHM
#define SUN_ALGORITHM 0
#endif
#ifndef SUN_OVERSAMPLE
#define SUN_OVERSAMPLE 1
#endif
#ifndef SUN_SWAP_LR
#define SUN_SWAP_LR 0
#endif
#ifndef SUN_AMP_ALPHA
#define SUN_AMP_ALPHA 0.02f       // brightness-reference tracking per sample (50 Hz -> about 1 s)
#endif
#ifndef SUN_SAT_COUNTS
#define SUN_SAT_COUNTS 4000       // at or above this a channel is too close to the ADC ceiling
#endif
#ifndef SUN_CACHE_US
#define SUN_CACHE_US 15000UL      // callers inside this window share one sample: telemetry reuses the
                                  // ADCS sample, the 20 ms ADCS loop itself always gets a fresh one
#endif

#if SUN_ALGORITHM == 1
#include "Config_SunCal.h"
#endif

#if SUN_SWAP_LR
#define SUN_PIN_L_EFF SUN_RIGHT_PIN
#define SUN_PIN_R_EFF SUN_LEFT_PIN
#else
#define SUN_PIN_L_EFF SUN_LEFT_PIN
#define SUN_PIN_R_EFF SUN_RIGHT_PIN
#endif

enum SunBranch { SUN_BR_NDV = 0, SUN_BR_RATIO = 1, SUN_BR_LEVEL = 2, SUN_BR_EDGE = 3, SUN_BR_NOSRC = 4 };

struct SunSample {
  int leftRaw;
  int rightRaw;
  float ndv;
  float angleDeg;
  float errorDeg;
  bool valid;
  // [Team] additions; the organisers' fields above are unchanged
  float leftAvg;      // averaged counts, before rounding
  float rightAvg;
  float x;            // ln(G_L/G_R) (algorithm 1) or NDV (algorithm 0)
  float lnSum;        // ln(G_L+G_R) (algorithm 1), 0 otherwise
  uint8_t branch;     // SunBranch
  bool saturated;
};

inline const char* sunBranchText(uint8_t b) {
  switch (b) {
    case SUN_BR_RATIO: return "RATIO";
    case SUN_BR_LEVEL: return "LEVEL";
    case SUN_BR_EDGE:  return "EDGE";
    case SUN_BR_NOSRC: return "NOSRC";
    default:           return "NDV";
  }
}

// ---------------------------------------------------------------------------
// brightness reference (algorithm 1)
// ---------------------------------------------------------------------------
static float _sunAmpRef = 0.0f;       // ln(brightness now / brightness at calibration)
static bool  _sunAmpValid = false;
static bool  _sunCacheValid = false;
static unsigned long _sunReadUs = 0;  // duration of the last ADC burst

inline float sunAmpRef() { return _sunAmpRef; }
inline bool  sunAmpRefValid() { return _sunAmpValid; }
inline void  sunRefReset() { _sunAmpRef = 0.0f; _sunAmpValid = false; _sunCacheValid = false; }
inline unsigned long sunLastReadMicros() { return _sunReadUs; }

#if SUN_ALGORITHM == 1

// Table lookup with linear interpolation; xs ascending. clip: -1 below, +1 above, 0 inside.
static inline float _sunInterp(const float *xs, const float *ys, int n, float x, int *clip) {
  if (clip) *clip = 0;
  if (x <= xs[0])     { if (clip && x < xs[0])     *clip = -1; return ys[0]; }
  if (x >= xs[n - 1]) { if (clip && x > xs[n - 1]) *clip = +1; return ys[n - 1]; }
  int i = 1;
  while (i < n - 1 && xs[i] < x) ++i;
  float f = (x - xs[i - 1]) / (xs[i] - xs[i - 1]);
  return ys[i - 1] + f * (ys[i] - ys[i - 1]);
}

static inline float _sunConductance(float counts, float gdark) {
  float c = counts;
  if (c < 1.0f) c = 1.0f;
  if (c > SUNCAL_COUNTS_AT_VCC - 1.0f) c = SUNCAL_COUNTS_AT_VCC - 1.0f;
  float g = c / (SUNCAL_COUNTS_AT_VCC - c) - gdark;
  return g < 1e-6f ? 1e-6f : g;
}

// Pure arithmetic: averaged counts in, angle/branch out. No hardware access, so
// tools/hosttest compiles and runs this function unchanged on a PC.
inline void sunRatioLevelEstimate(float avgL, float avgR, SunSample &s) {
  const int n = SUNCAL_N;
  float gL = _sunConductance(avgL, SUNCAL_GDARK_L);
  float gR = _sunConductance(avgR, SUNCAL_GDARK_R);
  float lnL = logf(gL), lnR = logf(gR);
  float X = lnL - lnR;
  float S = logf(gL + gR);
  s.x = X;
  s.lnSum = S;

  float amp = _sunAmpValid ? _sunAmpRef : 0.0f;
  // The thresholds ride with the lamp: twice the brightness, twice the stray light.
  bool darkL = (SUNCAL_LN_EDGE_L > -90.0f) && (lnL - amp < SUNCAL_LN_EDGE_L);
  bool darkR = (SUNCAL_LN_EDGE_R > -90.0f) && (lnR - amp < SUNCAL_LN_EDGE_R);
  bool inTable = (X >= SUNCAL_X[0]) && (X <= SUNCAL_X[n - 1]);

  if (inTable && !darkL && !darkR) {
    s.angleDeg = _sunInterp(SUNCAL_X, SUNCAL_ANG, n, X, nullptr);
    s.branch = SUN_BR_RATIO;
    // brightness-immune answer: use it to learn how far the lamp is from calibration
    float err = S - _sunInterp(SUNCAL_X, SUNCAL_S, n, X, nullptr);
    if (!_sunAmpValid) { _sunAmpRef = err; _sunAmpValid = true; }
    else               { _sunAmpRef += SUN_AMP_ALPHA * (err - _sunAmpRef); }
  } else {
    bool litIsL;
    if (darkL != darkR)             litIsL = darkR;
    else if (X > SUNCAL_X[n - 1])   litIsL = true;
    else if (X < SUNCAL_X[0])       litIsL = false;
    else                            litIsL = (gL >= gR);

    const float *xs = litIsL ? SUNCAL_LVL_L_X : SUNCAL_LVL_R_X;
    const float *ys = litIsL ? SUNCAL_LVL_L_ANG : SUNCAL_LVL_R_ANG;
    int m = litIsL ? SUNCAL_LVL_L_N : SUNCAL_LVL_R_N;
    if (m >= 2) {
      int clip = 0;
      s.angleDeg = _sunInterp(xs, ys, m, (litIsL ? lnL : lnR) - amp, &clip);
      s.branch = (clip < 0) ? SUN_BR_EDGE : SUN_BR_LEVEL;   // dimmer than the last row = past the table
    } else {
      s.angleDeg = litIsL ? SUNCAL_ANG[n - 1] : SUNCAL_ANG[0];
      s.branch = SUN_BR_EDGE;
    }
  }
  if ((SUNCAL_LN_MIN_SUM > -90.0f) && (S - amp < SUNCAL_LN_MIN_SUM)) s.branch = SUN_BR_NOSRC;
}
#endif  // SUN_ALGORITHM == 1

// ---------------------------------------------------------------------------
// hardware
// ---------------------------------------------------------------------------
inline void sunSensorBegin() {
  pinMode(SUN_LEFT_PIN, INPUT);
  pinMode(SUN_RIGHT_PIN, INPUT);
}

// Interleaved so lamp flicker and supply ripple land on both channels alike.
inline void sunReadCounts(float &avgL, float &avgR) {
  unsigned long t0 = micros();
  uint32_t accL = 0, accR = 0;
  for (int i = 0; i < SUN_OVERSAMPLE; ++i) {
    accL += (uint32_t)analogRead(SUN_PIN_L_EFF);
    accR += (uint32_t)analogRead(SUN_PIN_R_EFF);
  }
  avgL = (float)accL / (float)SUN_OVERSAMPLE;
  avgR = (float)accR / (float)SUN_OVERSAMPLE;
  _sunReadUs = micros() - t0;
}

// Diagnostic only (SUN_STATUS): the same nodes in calibrated millivolts.
inline void sunReadMilliVolts(float &mvL, float &mvR) {
  uint32_t accL = 0, accR = 0;
  for (int i = 0; i < 16; ++i) {
    accL += analogReadMilliVolts(SUN_PIN_L_EFF);
    accR += analogReadMilliVolts(SUN_PIN_R_EFF);
  }
  mvL = (float)accL / 16.0f;
  mvR = (float)accR / 16.0f;
}

inline bool sunSensorRead(SunSample &s) {
  static SunSample cache;
  static unsigned long cacheUs = 0;
  if (SUN_CACHE_US > 0 && _sunCacheValid && (micros() - cacheUs) < SUN_CACHE_US) {
    s = cache;
    return s.valid;
  }

  float aL, aR;
  sunReadCounts(aL, aR);
  s.leftAvg = aL;
  s.rightAvg = aR;
  s.leftRaw = (int)lroundf(aL);
  s.rightRaw = (int)lroundf(aR);
  s.saturated = (aL >= (float)SUN_SAT_COUNTS) || (aR >= (float)SUN_SAT_COUNTS);
  s.x = 0.0f;
  s.lnSum = 0.0f;
  s.branch = SUN_BR_NDV;

  float sum = aL + aR;
  if (sum <= 0.0f) {
    s.ndv = 0.0f;
    s.angleDeg = 0.0f;
    s.errorDeg = 0.0f;
    s.valid = false;
    _sunCacheValid = false;
    return false;
  }

  s.ndv = (aL - aR) / sum;   // always the organisers' raw-count NDV, for their telemetry
#if SUN_ALGORITHM == 1
  sunRatioLevelEstimate(aL, aR, s);
#else
  s.angleDeg = estimateSunAngle(s.ndv);
  s.x = s.ndv;
#endif
  s.errorDeg = -s.angleDeg; // legacy T03 field; T04 computes target-dependent error in ADCS.h
  s.valid = true;

  cache = s;
  cacheUs = micros();
  _sunCacheValid = true;
  return true;
}
